## board/devicesolutions/opal6boards/Kconfig
```kconfig
if TARGET_DEVICESOLUTIONSOPAL6BOARDS

config SYS_BOARD
	default "opal6boards"

config SYS_VENDOR
	default "devicesolutions"

config SYS_CONFIG_NAME
	default "opal6boards"

endif
```

## configs/dsopal6_defconfig
```kconfig
CONFIG_SYS_EXTRA_OPTIONS="IMX_CONFIG=board/devicesolutions/opal6boards/opal-6dl.cfg,MX6DL,DDR_MB=1024,ENV_IS_IN_MMC"
CONFIG_ARM=y
CONFIG_TARGET_DEVICESOLUTIONSMX6BOARDS=y
```

## configs/dsopal6manufacturing_defconfig
```kconfig
CONFIG_SYS_EXTRA_OPTIONS="IMX_CONFIG=board/devicesolutions/opal6boards/opal-6dl.cfg,MX6DL,DDR_MB=1024,ENV_IS_NOWHERE"
CONFIG_ARM=y
CONFIG_TARGET_DEVICESOLUTIONSOPAL6BOARDS=y
```

## configs/opal6dl2g_mfgtool_defconfig
```kconfig
CONFIG_SYS_EXTRA_OPTIONS="IMX_CONFIG=board/devicesolutions/opal6boards/opal-6dl2g.cfg,MX6DL,DDR_MB=2048,ENV_IS_NOWHERE,OPAL6_MFGTOOL"
CONFIG_ARM=y
CONFIG_TARGET_DEVICESOLUTIONSOPAL6BOARDS=y
```

## configs/opal6q2g_defconfig
```kconfig
CONFIG_SYS_EXTRA_OPTIONS="IMX_CONFIG=board/devicesolutions/opal6boards/opal-6q2g.cfg,MX6Q,DDR_MB=2048,ENV_IS_IN_MMC"
CONFIG_ARM=y
CONFIG_TARGET_DEVICESOLUTIONSOPAL6BOARDS=y
```

## configs/opal6q2g_mfgtool_defconfig
```kconfig
CONFIG_SYS_EXTRA_OPTIONS="IMX_CONFIG=board/devicesolutions/opal6boards/opal-6q2g.cfg,MX6Q,DDR_MB=2048,OPAL6_MFGTOOL,ENV_IS_NOWHERE"
CONFIG_ARM=y
CONFIG_TARGET_DEVICESOLUTIONSOPAL6BOARDS=y
```

## configs/opal6q_mfgtool_defconfig
```kconfig
CONFIG_SYS_EXTRA_OPTIONS="IMX_CONFIG=board/devicesolutions/opal6boards/opal-6q.cfg,MX6Q,DDR_MB=1024,OPAL6_MFGTOOL,ENV_IS_NOWHERE"
CONFIG_ARM=y
CONFIG_TARGET_DEVICESOLUTIONSOPAL6BOARDS=y
```

## configs/opal6qp_defconfig
```kconfig
CONFIG_SYS_EXTRA_OPTIONS="IMX_CONFIG=board/devicesolutions/opal6boards/opal-6qp.cfg,MX6Q,DDR_MB=1024,ENV_IS_IN_MMC"
CONFIG_ARM=y
CONFIG_TARGET_DEVICESOLUTIONSOPAL6BOARDS=y
```
